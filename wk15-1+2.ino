int fstones[] = {
  0, 185, 207, 233, 247, 277, 311, 349, 370, 293//293 D4
};
int gtones[] = {
  0, 196, 220, 247, 262, 294, 330, 367, 392, 311//311 D4#
};
int pre[][2] ={
  {6,-1},{0,1},{6,-1},{5,-1},{6,-1}, {6,-1},{0,1},{6,-1},{5,-1},{6,-1},
  {6,-1},{0,1},{6,-1},{5,-1},{6,-1}, {6,-1},{6,-1},{1,0}, {2,0},{1,0},{2,0},
  {6,-1},{0,1},{6,-1},{5,-1},{6,-1}, {6,-1},{0,1},{6,-1},{5,-1},{6,-1},
  {6,-1},{0,1},{6,-1},{5,-1},{6,-1}, {2,0},{1,0},{2,0}, {1,0},{6,-1},{1,0}
};

int me1[][2] = {
  {6,-1},{7,-1},{1,0} ,{2,0},{3,0} ,{6,0} ,{5,0} ,
  {3,0} ,{6,-1},{3,0} ,{2,0},{1,0} ,{7,-1}       ,
  {6,-1},{7,-1},{1,0} ,{2,0},{3,0} ,{2,0} ,{1,0} ,
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  {7,-1},{1,0} ,{2,0} ,{3,0}

};
int me2[][2]={
  {5,0},{6,0},{3,0},{2,0},{3,0}, {2,0},{3,0},
  {5,0},{6,0},{3,0},{2,0},{3,0}, {2,0},{3,0},
  {2,0},{1,0},{7,-1},{5,-1},{6,-1}, {5,-1},{6,-1},
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  {2,0},{1,0},{7,-1},{5,-1},{6,-1},{3,0},{5,0}
};

int end[][2]={
  {6,-1},{6,-1},{6,-1},{6,-1},{6,-1},{6,-1},{6,-1},{6,-1},
  {6,-1},{6,-1},{6,-1},{6,-1},{6,-1},{6,-1},{6,-1},{6,-1},
  {6,-1},{6,-1},{6,-1},{6,-1},{6,-1},{6,-1},{6,-1},{6,-1},
  {6,-1},{6,-1},{6,-1},{6,-1},{6,-1},{6,-1},{6,-1},{0,0}
};

int lenPre=42;
int noteDurationsPre[] = {
  4,16,16,16,16, 4,16,16,16,16,
  4,16,16,16,16, 8,16,16,8,16,16,
  4,16,16,16,16, 4,16,16,16,16,
  4,16,16,16,16, 8,16,16,8,16,16
};
int len1=28+24;
int noteDurations1[] = {
  8,8,8,8,4,8,8,
  4,4,8,8,8,8,
  8,8,8,8,4,8,8,
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  4,4,4,4
};
int len2=7*4*4;
int noteDurations2[] = {
  8,8,8,8,4,8,8,
  8,8,8,8,4,8,8,
  8,8,8,8,4,8,8,
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  8,8,8,8,4,8,8
};
int lenEnd=8*4;
int noteDurationsEnd[] = {
  3,16,8,16,3,16,8,16,
  3,16,8,16,3,16,8,16,
  3,16,8,16,3,16,8,16,
  3,16,8,16,3,16,8,8

};
int FSTone(int i,int s){
  int b = fstones[i];
  while(s>0){
    b*=2;
    s--;
  }
  while(s<0){
    b/=2;
    s++;
  }
  return b;
}

int GTone(int i,int s){
  int a = gtones[i];
  while(s>0){
    a*=2;
    s--;
  }
  while(s<0){
    a/=2;
    s++;
  }
  return a;
}
void PlaySection(int secLen,int melody[][2],int noteDurations[], int len,int (*GetTone)(int,int)){
	for (int i = 0; i < len; i++) {
   	  int noteDuration = secLen/noteDurations[i];
      tone(10, GetTone(melody[i][0],melody[i][1]), noteDuration);
      if(melody[i][0]!=0&&melody[i][0]!=9){digitalWrite(melody[i][0]+1,HIGH);}
      int pauseBetweenNotes = noteDuration * 1.5;
      delay(pauseBetweenNotes);
      noTone(10);
      if(melody[i][0]!=0&&melody[i][0]!=0)digitalWrite(melody[i][0]+1,LOW);
    }
}

void setup() {
  for(byte i=2;i<10;i++)
    pinMode(i,OUTPUT);
}

void loop() {
  PlaySection(900,pre,noteDurationsPre,lenPre,&FSTone);

  PlaySection(900,me1,noteDurations1,len1,&FSTone);
  PlaySection(900,me1,noteDurations1,len1,&FSTone);
  PlaySection(900,me2,noteDurations2,len2,&FSTone);
  PlaySection(940,me2,noteDurations2,len2-2,&GTone);
  PlaySection(910,pre,noteDurationsPre,lenPre,&GTone);
  PlaySection(910,me1,noteDurations1,len1,&GTone);
  PlaySection(910,me2,noteDurations2,len2-2,&GTone);

  PlaySection(900,end,noteDurationsEnd,lenEnd,&FSTone);

  delay(600);
}
